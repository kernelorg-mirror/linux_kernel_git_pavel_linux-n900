## Documentation/devicetree/bindings/iio/light/avago-apds990x.txt
```
Avago APDS990X light sensor

https://docs.broadcom.com/docs/AV02-2867EN

Required properties:
- compatible: "avago,apds990x"
- reg: address on the I2C bus
- interrupts: external interrupt line number
- vdd-supply: power supply for VDD
- vled-supply: power supply for LEDA
- avago,glass-coef: Glass attenuation coefficient. Fixed point, 4096 == 1.00.
- avago,cf1: Clear channel factor 1. Fixed point, 4096 == 1.00.
- avago,irf1: IR channel factor 1. Fixed point, 4096 == 1.00.
- avago,cf2: Clear channel factor 2. Fixed point, 4096 == 1.00.
- avago,irf2: IR channel factor 2. Fixed point, 4096 == 1.00.
- avago,df: Device factor. Fixed point, 4096 == 1.00.
- avago,pdrive: IR current, one of APDS_IRLED_CURR_XXXmA values
- avago,ppcount: Proximity pulse count

Example (Nokia N9):

	light-sensor@39 {
		compatible = "avago,apds990x";
		reg = <0x39>;

		interrupt-parent = <&gpio3>;
		interrupts = <19 (IRQ_TYPE_EDGE_FALLING | IRQ_TYPE_LEVEL_LOW)>; /* gpio_83 */

		vdd-supply = <&vaux1>;
		vled-supply = <&vbat>;

		avago,ga	= <168834>;
		avago,cf1	= <4096>;
		avago,irf1	= <7824>;
		avago,cf2	= <877>;
		avago,irf2	= <1575>;
		avago,df	= <52>;

		avago,pdrive	= <0x2>; /* APDS_IRLED_CURR_25mA */
		avago,ppcount	= <5>;
	};
```

## Documentation/devicetree/bindings/media/ti-wl1273.txt
```
Rob:

bluetooth chips have a binding location: bindings/net/bluetooth.

And we already have a WL1273 binding. Plus there's the one for the Nokia
BT which I think can be TI chips with a different firmware and protocol.
Is this related?

#
# See: Rob Herring            Re: [PATCH] dt-bindings: Nokia N9 audio sup
#

Texas Instruments - wl1273 radio/bluetooth module

Required properties:

- compatible: "ti,wl1273-core"
- reg: I2C slave address
- interrupts: The interrupt output from the device.
- interrupt-parent: The parent interrupt controller.
- power-gpio: gpio pin to power the device.

Mandatory subnode:

- wl1273radio child: compatible = "ti,wl1273-fm-radio";

Optional subnode:

- wl1273codec child:compatible = "ti,wl1273-codec";

Example:

wl1273core: wl1273core@22 {
		compatible = "ti,wl1273-core";
		reg = <0x22>;

		pinctrl-names = "default";
		pinctrl-0 = <&wl1273_gpio>;

		interrupt-parent = <&gpio2>;
		interrupts = <11 2>; /* gpio_43, IRQF_TRIGGER_FALLING */

		wl1273radio: wl1273radio {
			compatible = "ti,wl1273-fm-radio";
		};

		wl1273codec: wl1273codec {
			compatible = "ti,wl1273-codec";
		};
	};
```

## Documentation/devicetree/bindings/sound/nokia,n9.txt
```
* Nokia N9/N950 audio setup

Required properties:
- compatible: "nokia,n9-audio"

- nokia,twl4030-cpu-dai: phandle for the McBSP node connected to TWL4030
- nokia,tlv320dac33-cpu-dai: phandle for the McBSP node connected to TLV320DAC33
- nokia,wl1273-cpu-dai: phandle for the McBSP node connected to WL1273

- nokia,twl4030-codec: phandle for the TWL4030 codec
- nokia,tlv320dac33-codec: phandle for the TLV320DAC33 codec
- nokia,wl1273-codec: phandle for the WL1273 codec
- nokia,headphone-amplifier: phandle for the TPA6130A2 node

- nokia,speaker-amplifier-gpios: GPIO for speaker amplifier

Example:

sound: n9-audio {
	compatible = "nokia,n9-audio";

	nokia,twl4030-cpu-dai = <&mcbsp3>;
	nokia,tlv320dac33-cpu-dai = <&mcbsp2>;
	nokia,wl1273-cpu-dai = <&mcbsp4>;

	nokia,twl4030-codec = <&twl4030_audio>;
	nokia,tlv320dac33-codec = <&tlv320dac33>;
	nokia,wl1273-codec = <&wl1273codec>;
	nokia,headphone-amplifier = <&tpa6140a2>;

	nokia,speaker-amplifier-gpios = <&twl_gpio 7 GPIO_ACTIVE_HIGH>;
};
```

## Documentation/devicetree/bindings/sound/tlv320dac33.txt
```
Texas Instruments - tlv320dac33 Codec module

The tlv320dac33 serial control bus communicates through I2C protocols.

Required properties:

- compatible - "ti,tlv320dac33"
- reg - I2C slave address
- ti,burst-bclkdiv - BCLK divider value in burst mode. Valid range is 1..255.

Optional properties:

- reset-gpios      - gpio pin to power the device, active high.

- interrupts       - The interrupt output from the device.
- interrupt-parent - The parent interrupt controller.

- ti,keep-bclk     - Keep the BCLK running in FIFO modes.

Example:

tlv320dac33: audio-codec@19 {
	compatible = "ti,tlv320dac33";
	reg = <0x19>;

	interrupt-parent = <&gpio2>;
	interrupts = <21 1>; /* gpio_53, IRQF_TRIGGER_RISING */
	reset-gpios = <&gpio2 28 0>; /* gpio_60 */

	ti,keep-bclk;
	ti,burst-bclkdiv = <3>;
};
```

## kernel/events/Kconfig
```kconfig
config NOHAMMER
        tristate "Rowhammer protection"
        help
	  Enable rowhammer attack prevention. Will degrade system
	  performance under attack so much that attack should not
	  be feasible. This will degrade performance when enabled.

	  To compile this driver as a module, choose M here: the
	  module will be called nohammer.
```
